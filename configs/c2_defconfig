## configs/c2_defconfig
```kconfig
CONFIG_STARRYSKY_C2=y
CONFIG_LINK_RAM_REGION_FLASH=y
CONFIG_CPU_FREQ_MHZ=72
CONFIG_UART_BAUD_RATE=115200
CONFIG_PSRAM_NUM=1
CONFIG_PSRAM_SCLK_MIN_FREQ_MHZ=12
CONFIG_PSRAM_SCLK_MAX_FREQ_MHZ=133
CONFIG_DRIVER_UART=y
CONFIG_DRIVER_GPIO=y
CONFIG_DRIVER_SPI=y
CONFIG_DRIVER_I2C=y
CONFIG_DRIVER_PWM=y
CONFIG_DRIVER_TIMER=y
CONFIG_BUILD_OPT_SPEED=y
CONFIG_LINK_TARGET_FLASH=y
CONFIG_FIRMWARE_NAME="mc_uart_fw"
CONFIG_FIRMWARE_VERSION="0.1.0"
```
